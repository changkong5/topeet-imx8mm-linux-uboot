## board/freescale/imx8mm_topeet/Kconfig
```kconfig
if TARGET_IMX8MM_TOPEET

config SYS_BOARD
	default "imx8mm_topeet"

config SYS_VENDOR
	default "freescale"

config SYS_CONFIG_NAME
	default "imx8mm_topeet"

config IMX8M_1G_MEMORY
	bool "imx8m 1GB memory size"

source "board/freescale/common/Kconfig"

endif
```

## board/freescale/mx6ull_topeet/Kconfig
```kconfig
if TARGET_MX6ULL_14X14_TOPEET

config SYS_BOARD
	default "mx6ull_topeet"

config SYS_VENDOR
	default "freescale"

config SYS_CONFIG_NAME
	default "mx6ull_topeet"

config SYS_TEXT_BASE
	default 0x87800000
endif
```
